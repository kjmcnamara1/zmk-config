/ {

  behaviors {

        hml: homerow_mod_left {
            compatible = "zmk,behavior-hold-tap";
            label = "HOMEROW_MOD_LEFT";
            bindings = <&kp>, <&kp>;
            flavor = "balanced";
            #binding-cells = <2>;
            tapping-term-ms = <200>;
            quick-tap-ms = <175>;
            require-prior-idle-ms = <150>;
            hold-trigger-on-release;
            hold-trigger-key-positions = <KEYS_R KEYS_T>;
        };

        hmr: homerow_mod_right {
            compatible = "zmk,behavior-hold-tap";
            label = "HOMEROW_MOD_RIGHT";
            bindings = <&kp>, <&kp>;
            flavor = "balanced";
            #binding-cells = <2>;
            tapping-term-ms = <200>;
            quick-tap-ms = <175>;
            require-prior-idle-ms = <150>;
            hold-trigger-key-positions = <KEYS_L KEYS_T>;
            hold-trigger-on-release;
        };

    };

};
